## DIR657GPL/SRC/ubicom-distro/linux-2.6.x/arch/ubicom32/mach-ip7k/Kconfig.board
```kconfig
#
# Add any board specific configuration sub-menus here
#

choice
	prompt "Display Detection"
	depends on FB_UBICOM32
	help
		Choose a display type for use with the board.

config DISPLAY_AUTODETECT
	bool "Auto Detect"
	help
		Auto detect display, late in boot sequence.

config DISPLAY_NOAUTODETECT
	bool "Not Auto Detected"
	select VDC_NOAUTODETECT
	help
		Select the connected display

endchoice

#
# IP7160RGWLCD
#
choice
	prompt "IP7160RGWLCD Display Type"
	depends on IP7160RGWLCD
	help
		Choose a display type for use with the board.

endchoice
```

## DIR657GPL/SRC/ubicom-distro/linux-2.6.x/arch/ubicom32/mach-ip8k/Kconfig
```kconfig
config IP8000QEMU
	bool "IP8000QEMU"
	select UBICOM32_V5
	select MMU
	select FPU
	help
		Ubicom IP8000 QEMU supports:
			8008-QEMU v1.0

config IP8000BRINGUP
	bool "IP8000BRINGUP"
	select UBICOM32_V5
	select MMU
	select FPU
	select NEW_LEDS
	select LEDS_CLASS
	select LEDS_GPIO
	select PCIEPORTBUS if PCI
	select ARCH_SUPPORTS_MSI if PCI
	select PCI_MSI if PCI
	help
		Ubicom IP8000 BringUp, supports:
			8008-0010 v1.0

config IP8100RGW
	bool "IP8100RGW"
	select UBICOM32_V5
	select MMU
	select FPU
	select UBICOM_INPUT
	select NEW_LEDS
	select LEDS_CLASS
	select LEDS_GPIO
	select SPI
	select SPI_UBICOM32_GPIO
	select VLAN_8021Q if NET
	select UBICOM_SWITCH
	select UBICOM_SWITCH_BCM539X
	select PCIEPORTBUS if PCI
	select I2C
	select I2C_GPIO
	select GPIO_PCA953X
	select MTD_UBI32_FC
	select MTD_UBI32_NAND_SPI_ER
	select UBICOM32_MULTI_FLASH
	select ARCH_SUPPORTS_MSI if PCI
	select PCI_MSI if PCI
	select PCI_DOMAINS if PCI
	help
		Ubicom IP8100 Router Gateway Eval, supports:
			8008-0010 v1.0	IP8K RGW Board

config IP8100DIR857
	bool "IP8100DIR857"
	select UBICOM32_V5
	select MMU
	select FPU
	select UBICOM_INPUT
	select NEW_LEDS
	select LEDS_CLASS
	select LEDS_GPIO
	select SPI
	select SPI_UBICOM32_GPIO
	select VLAN_8021Q if NET
	select UBICOM_SWITCH
	select UBICOM_SWITCH_AR8327
	select PCIEPORTBUS if PCI
	select I2C
	select I2C_GPIO
	select GPIO_PCA953X
	select MTD_UBI32_FC
	select MTD_UBI32_NAND_SPI_ER
	select ARCH_SUPPORTS_MSI if PCI
	select PCI_MSI if PCI
	select PCI_DOMAINS if PCI
	help
		Ubicom IP8100 Router Gateway Eval, supports:
			8008-0010 v1.0	IP8K RGW Board

config IP8500TAP
	bool "IP8500TAP"
	select UBICOM32_V5
	select PCIEPORTBUS if PCI
	select ARCH_SUPPORTS_MSI if PCI
	select PCI_MSI if PCI
	select PCI_DOMAINS if PCI
	select MMU
	select FPU
	select NEW_LEDS
	select LEDS_CLASS
	select LEDS_GPIO
	select RTC_CLASS
	select RTC_DRV_S35390A
	select I2C
	select I2C_GPIO
	select AT24
	select MAX4550
	select GPIO_PCA953X
	select MTD_UBI32_FC
	select MTD_UBI32_NAND_SPI_ER
	select UBICOM32_MULTI_FLASH
	select UBICOM32_LCD_ADAPTER
	select SND if SOUND
	select SND_UBI32 if SOUND
	select SND_UBI32_AUDIO_CS4384 if SOUND
	select FB_UBICOM32 if FB
	select TOUCHSCREEN_TSC2007 if INPUT_TOUCHSCREEN
	select LCD_CLASS_DEVICE
	select LCD_UBICOM32POWER
	select VDC_LCD_SYNC
	select VDC_LCD_BITBANG_16
	help
		Ubicom IP8500 TotalAudio Eval, supports:
		8008-0010 v1.0
```
